## boards/espressif/webos_esp32s3/Kconfig
```kconfig
# Copyright (c) 2025 WebOS
# SPDX-License-Identifier: Apache-2.0

config HEAP_MEM_POOL_ADD_SIZE_BOARD
	int
	default 4096 if BOARD_WEBOS_ESP32S3_ESP32S3_PROCPU
```

## boards/espressif/webos_esp32s3/Kconfig.webos_esp32s3
```kconfig
# Copyright (c) 2025 WebOS
# SPDX-License-Identifier: Apache-2.0

config BOARD_WEBOS_ESP32S3
	select SOC_ESP32S3_WROOM_N16R8
	select SOC_ESP32S3_PROCPU if BOARD_WEBOS_ESP32S3_ESP32S3_PROCPU
```

## boards/espressif/webos_esp32s3/board.yml
```yaml
board:
  name: webos_esp32s3
  full_name: WebOS ESP32-S3
  vendor: webos
  socs:
  - name: esp32s3
```

## drivers/Kconfig
```kconfig
# Copyright (c) 2021 Nordic Semiconductor ASA
# SPDX-License-Identifier: Apache-2.0

menu "Drivers"
rsource "blink/Kconfig"
rsource "webos_gpio/Kconfig"
rsource "webos_rgbled/Kconfig"
rsource "sensor/Kconfig"
endmenu
```

## drivers/webos_gpio/Kconfig
```kconfig
# SPDX-License-Identifier: Apache-2.0

config WEBOS_GPIO
	bool "WebOS GPIO devfs wrapper"
	depends on WEBOS_DEVFS
	depends on GPIO
	help
	  Register webos,gpio devicetree nodes as /dev/gpio/<n> files.
```

## drivers/webos_rgbled/Kconfig
```kconfig
# SPDX-License-Identifier: Apache-2.0

config WEBOS_RGBLED
	bool "WebOS RGB LED strip devfs wrapper"
	depends on WEBOS_DEVFS
	depends on LED_STRIP
	help
	  Register webos,rgbled devicetree nodes as /dev/rgbled/<n>/color files.

config WEBOS_RGBLED_MAX_PIXELS
	int "Maximum pixels updated by each WebOS RGB LED node"
	depends on WEBOS_RGBLED
	default 8
	help
	  Upper bound for stack pixel buffers used when mirroring one color across
	  the referenced Zephyr LED strip.
```

## dts/bindings/gpio/webos,gpio.yaml
```yaml
# SPDX-License-Identifier: Apache-2.0

description: WebOS GPIO device exported through devfs

compatible: "webos,gpio"

include: base.yaml

properties:
  gpios:
    type: phandle-array
    required: true
    description: Zephyr GPIO referenced by this WebOS GPIO device.
```

## dts/bindings/led/webos,rgbled.yaml
```yaml
# SPDX-License-Identifier: Apache-2.0

description: WebOS RGB LED strip exported through devfs

compatible: "webos,rgbled"

include: base.yaml

properties:
  led:
    type: phandle
    required: true
    description: Zephyr LED strip device backing this devfs node.

  webos-pin:
    type: int
    required: true
    description: Logical GPIO pin number used in the /dev/rgbled/<n>/color path.
```

## west.yml
```yaml
# Copyright (c) 2021 Nordic Semiconductor ASA
# SPDX-License-Identifier: Apache-2.0

manifest:
  self:
    west-commands: scripts/west-commands.yml

  remotes:
    - name: zephyrproject-rtos
      url-base: https://github.com/zephyrproject-rtos
    - name: letanphuc
      url-base: https://github.com/letanphuc

  projects:
    - name: wasm-micro-runtime
      remote: letanphuc
      revision: main
      path: modules/wasmmicroruntime
    - name: zephyr
      remote: zephyrproject-rtos
      revision: main
      import:
        # By using name-allowlist we can clone only the modules that are
        # strictly needed by the application.
        name-allowlist:
          - hal_espressif # required by ESP32-S3 boards
          - fatfs         # FatFS payload/config storage
          - mbedtls       # TLS support for the management server
          - tf-psa-crypto # PSA crypto backend used by Wi-Fi security
          - mcuboot       # firmware update and rollback support
```
